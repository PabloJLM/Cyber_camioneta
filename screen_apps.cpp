#include "Apps/screen_apps.h"
#include "Drivers/buzzer.h"
#include "config.h"


static const unsigned char image_download_bits_wifi[] PROGMEM = {
	0x00, 0x00, 0x00, 0x00, 0x00, 0x00, 0x00, 0x00, 0x00, 0x00, 0x00, 0x00, 0x00, 0x00, 0x00, 0x00, 
	0xc0, 0x03, 0x00, 0x00, 0x00, 0xfe, 0x7f, 0x00, 0x00, 0x80, 0xff, 0xff, 0x01, 0x00, 0xe0, 0xff, 
	0xff, 0x07, 0x00, 0xf8, 0x1f, 0xf8, 0x1f, 0x00, 0xfc, 0x01, 0x80, 0x3f, 0x00, 0x7e, 0x00, 0x00, 
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	0x00, 0x00, 0x00, 0x00, 0x00, 0x00, 0x00, 0x00, 0x00, 0x00, 0x00, 0x00, 0x00, 0x00, 0x00, 0x00
};

static const unsigned char image_Dehumidify_hvr_bits[] PROGMEM = {
  0xf8,0xff,0x3f,0x00,0xfc,0xff,0x7f,0x00,0xfe,0xff,0xff,0x00,0xff,0xff,0xff,0x01,
  0xff,0xff,0xff,0x01,0xff,0xef,0xff,0x01,0xff,0xef,0xff,0x01,0xff,0xe7,0xff,0x01,
  0xff,0xc7,0xff,0x01,0xff,0xc3,0xff,0x01,0xff,0x83,0xff,0x01,0xff,0x01,0xff,0x01,
  0xff,0x01,0xff,0x01,0xff,0x40,0xfe,0x01,0xff,0x80,0xfe,0x01,0x7f,0x80,0xfc,0x01,
  0x7f,0x00,0xfc,0x01,0xff,0x00,0xfe,0x01,0xff,0x00,0xfe,0x01,0xff,0x01,0xff,0x01,
  0xff,0x87,0xff,0x01,0xff,0xff,0xff,0x01,0xff,0xff,0xff,0x01,0xff,0xff,0xff,0x01,
  0xfe,0xff,0xff,0x00,0xfc,0xff,0x7f,0x00,0xf8,0xff,0x3f,0x00
};

static const unsigned char image_operation_warning_bits[] PROGMEM = {
  0x00,0x00,0x80,0x01,0x40,0x02,0x40,0x02,0x20,0x04,0x90,0x09,0x90,0x09,0x88,0x11,
  0x88,0x11,0x84,0x21,0x02,0x40,0x82,0x41,0x81,0x81,0x01,0x80,0xfe,0x7f,0x00,0x00
};

static const unsigned char image_bluetooth_bits[] PROGMEM = {
  0x80,0x00,0x40,0x01,0x40,0x02,0x44,0x04,0x48,0x04,0x50,0x02,0x60,0x01,0xc0,0x00,
  0x60,0x01,0x50,0x02,0x48,0x04,0x44,0x04,0x40,0x02,0x40,0x01,0x80,0x00,0x00,0x00
};

static const unsigned char image_pcmode_placeholder_bits[] PROGMEM = {
  0xff,0xff,0xff,0xff,0x01,0x00,0x00,0x80,0x01,0x00,0x00,0x80,0x01,0x00,0x00,0x80,
  0x01,0x00,0x00,0x80,0x01,0x00,0x00,0x80,0x01,0x00,0x00,0x80,0x01,0x00,0x00,0x80,
  0x01,0x00,0x00,0x80,0x01,0x00,0x00,0x80,0x01,0x00,0x00,0x80,0x01,0x00,0x00,0x80,
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  0x01,0x00,0x00,0x80,0x01,0x00,0x00,0x80,0x01,0x00,0x00,0x80,0xff,0xff,0xff,0xff
};

static const unsigned char image_location_map_bits[] PROGMEM = {
  0x00,0xf0,0x03,0x00,0x00,0xf0,0x03,0x00,0x00,0x0c,0x0c,0x00,0x00,0x0c,0x0c,0x00,
  0x00,0xc3,0x30,0x00,0x00,0xc3,0x30,0x00,0xc0,0x30,0xc3,0x00,0xc0,0x30,0xc3,0x00,
  0xc0,0x30,0xc3,0x00,0xc0,0x30,0xc3,0x00,0xc0,0xc0,0xc0,0x00,0xc0,0xc0,0xc0,0x00,
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  0xc3,0x0f,0xfc,0x30,0xc3,0x0f,0xfc,0x30,0x3f,0xf0,0x03,0x3f,0x3f,0xf0,0x03,0x3f
};

static const unsigned char image_location_bits[] PROGMEM = {
  0xf0,0x01,0x0c,0x06,0x02,0x08,0xe2,0x08,0x11,0x11,0x09,0x12,0x09,0x12,0x0a,0x0a,
  0x12,0x09,0xe4,0x04,0x04,0x04,0x08,0x02,0x10,0x01,0xa0,0x00,0xe0,0x00,0x40,0x00
};

static const unsigned char image_wifi_bits[] PROGMEM = {
  0x80,0x0f,0x00,0x60,0x30,0x00,0x18,0xc0,0x00,0x84,0x0f,0x01,0x62,0x30,0x02,0x11,
  0x40,0x04,0x08,0x87,0x00,0xc4,0x18,0x01,0x20,0x20,0x00,0x10,0x42,0x00,0x80,0x0d,
  0x00,0x40,0x10,0x00,0x00,0x02,0x00,0x00,0x05,0x00,0x00,0x02,0x00,0x00,0x00,0x00
};

static const unsigned char image_InfraredArrowDown_bits[] PROGMEM = {
  0xff,0xff,0xff,0xff,0xfc,0x3f,0xfc,0x3f,0xf0,0x0f,0xf0,0x0f,0xc0,0x03,0xc0,0x03
};

static const unsigned char image_InfraredArrowUp_bits[] PROGMEM = {
  0xc0,0x03,0xc0,0x03,0xf0,0x0f,0xf0,0x0f,0xfc,0x3f,0xfc,0x3f,0xff,0xff,0xff,0xff
};

static const unsigned char image_download_1_bits[] PROGMEM = {
  0xc0,0x03,0xc0,0x03,0xf0,0x0f,0xf0,0x0f,0xfc,0x3f,0xfc,0x3f,0xff,0xff,0xff,0xff
};

static const unsigned char image_download_bits[] PROGMEM = {
  0xff,0xff,0xff,0xff,0xfc,0x3f,0xfc,0x3f,0xf0,0x0f,0xf0,0x0f,0xc0,0x03,0xc0,0x03
};


static bool isButtonJustPressed(int pin) {
  static uint8_t lastStableState[4] = {HIGH, HIGH, HIGH, HIGH};
  static uint8_t lastReading[4]     = {HIGH, HIGH, HIGH, HIGH};
  static unsigned long lastDebounceTime[4] = {0, 0, 0, 0};

  const int pins[4] = {PIN_SELECT, PIN_UP, PIN_DOWN, PIN_BACK};
  int index = -1;

  for (int i = 0; i < 4; i++) {
    if (pins[i] == pin) {
      index = i;
      break;
    }
  }
  if (index == -1) return false;

  uint8_t reading = digitalRead(pin);

  if (reading != lastReading[index]) {
    lastDebounceTime[index] = millis();
    lastReading[index] = reading;
  }

  if ((millis() - lastDebounceTime[index]) > 50) {
    if (lastStableState[index] == HIGH && reading == LOW) {
      lastStableState[index] = reading;
      return true;
    }
    lastStableState[index] = reading;
  }

  return false;
}


static int appSelection = 0;
static const int TOTAL_APPS = 11;


void drawWifiCaptivePortal() {
  u8g2.setFontMode(1);
  u8g2.setBitmapMode(1);
  u8g2.drawXBM(8, 40, 16, 8, image_download_bits);
  u8g2.drawXBM(8, 23, 16, 8, image_download_1_bits);
  u8g2.setFont(u8g2_font_6x10_tr);
  u8g2.drawStr(30, 15, "Wifi Captive");
  u8g2.drawStr(47, 25, "Portal");
  u8g2.drawXBM(48, 28, 38, 32, image_download_bits_wifi);
}

void drawAPFlood() {
  u8g2.setFontMode(1);
  u8g2.setBitmapMode(1);
  u8g2.drawXBM(8, 40, 16, 8, image_download_bits);
  u8g2.drawXBM(8, 23, 16, 8, image_download_1_bits);
  u8g2.setFont(u8g2_font_6x10_tr);
  u8g2.drawStr(40, 19, "AP Flood");
  u8g2.drawXBM(54, 23, 25, 27, image_Dehumidify_hvr_bits);
  u8g2.drawXBM(43, 28, 16, 16, image_operation_warning_bits);
}

void drawBluetoothSpam() {
  u8g2.setFontMode(1);
  u8g2.setBitmapMode(1);
  u8g2.drawXBM(8, 40, 16, 8, image_download_bits);
  u8g2.drawXBM(8, 23, 16, 8, image_download_1_bits);
  u8g2.setFont(u8g2_font_6x10_tr);
  u8g2.drawStr(37, 11, "Bluetooth");
  u8g2.drawStr(52, 19, "Spam");
  u8g2.drawXBM(56, 28, 14, 16, image_bluetooth_bits);
  u8g2.drawEllipse(63, 35, 14, 12);
}

void drawGPSPosition() {
  u8g2.setFontMode(1);
  u8g2.setBitmapMode(1);
  u8g2.drawXBM(8, 40, 16, 8, image_download_bits);
  u8g2.drawXBM(8, 23, 16, 8, image_download_1_bits);
  u8g2.setFont(u8g2_font_6x10_tr);
  u8g2.drawStr(40, 11, "Posicion");
  u8g2.drawStr(52, 19, "GPS");
  u8g2.drawXBM(46, 21, 30, 32, image_location_map_bits);
}

void drawWardriving() {
  u8g2.setFontMode(1);
  u8g2.setBitmapMode(1);
  u8g2.drawXBM(8, 40, 16, 8, image_download_bits);
  u8g2.drawXBM(8, 23, 16, 8, image_download_1_bits);
  u8g2.setFont(u8g2_font_6x10_tr);
  u8g2.drawStr(33, 11, "Wardriving");
  u8g2.drawXBM(46, 27, 19, 16, image_wifi_bits);
  u8g2.drawXBM(68, 27, 13, 16, image_location_bits);
}

void drawSniffer() {
  u8g2.setFontMode(1);
  u8g2.setBitmapMode(1);
  u8g2.drawXBM(8, 40, 16, 8, image_download_bits);
  u8g2.drawXBM(8, 23, 16, 8, image_download_1_bits);
  u8g2.setFont(u8g2_font_6x10_tr);
  u8g2.drawStr(47, 20, "Sniffer");
  u8g2.drawXBM(48, 23, 38, 32, image_download_bits_wifi);
}

void drawPCMode() {
  u8g2.setFontMode(1);
  u8g2.setBitmapMode(1);
  u8g2.drawXBM(8, 40, 16, 8, image_download_bits);
  u8g2.drawXBM(8, 23, 16, 8, image_download_1_bits);
  u8g2.setFont(u8g2_font_6x10_tr);
  u8g2.drawStr(43, 12, "PC-Mode");
  u8g2.drawFrame(38, 17, 52, 29);
  u8g2.drawVLine(69, 45, 7);
  u8g2.drawVLine(54, 45, 7);
  u8g2.drawHLine(42, 51, 40);
  u8g2.drawRBox(41, 20, 46, 23, 3);
  u8g2.drawFrame(42, 51, 40, 10);
  u8g2.drawHLine(45, 55, 15);
  u8g2.drawDisc(76, 55, 2);
}

void drawYModem() {
  u8g2.setFontMode(1);
  u8g2.setBitmapMode(1);
  u8g2.drawXBM(8, 40, 16, 8, image_download_bits);
  u8g2.drawXBM(8, 23, 16, 8, image_download_1_bits);
  u8g2.setFont(u8g2_font_6x10_tr);
  u8g2.drawStr(43, 9, "YMODEM");
  u8g2.drawFrame(50, 13, 22, 14);
  u8g2.drawBox(54, 17, 5, 5);
  u8g2.drawBox(63, 17, 5, 5);
  u8g2.drawBox(66, 35, 0, 0);
  u8g2.drawFrame(48, 26, 26, 28);
  u8g2.drawBox(58, 53, 5, 16);
  u8g2.drawBox(81, 34, 3, 12);
  u8g2.drawDisc(60, 48, 2);
  u8g2.drawDisc(55, 38, 1);
  u8g2.drawVLine(60, 30, 18);
  u8g2.drawLine(60, 29, 62, 31);
  u8g2.drawLine(60, 29, 58, 31);
  u8g2.drawLine(60, 29, 58, 31);
  u8g2.drawLine(60, 41, 65, 35);
  u8g2.drawLine(60, 45, 55, 39);
  u8g2.drawTriangle(78, 35, 86, 35, 82, 29);
}

void drawBleScan() {
  u8g2.setFontMode(1);
  u8g2.setBitmapMode(1);
  u8g2.drawXBM(8, 40, 16, 8, image_download_bits);
  u8g2.drawXBM(8, 23, 16, 8, image_download_1_bits);
  u8g2.setFont(u8g2_font_6x10_tr);
  u8g2.drawStr(55, 9, "BLE");
  u8g2.drawStr(45, 18, "Scanner");
  u8g2.drawXBM(59, 29, 14, 16, image_bluetooth_bits);
  u8g2.drawCircle(65, 36, 10);
  u8g2.drawLine(72, 43, 82, 51);
  u8g2.drawLine(74, 44, 84, 52);
  u8g2.drawLine(74, 42, 84, 50);
}

void drawMsgPreset() {
  u8g2.setFontMode(1);
  u8g2.setBitmapMode(1);
  u8g2.drawXBM(8, 40, 16, 8, image_download_bits);
  u8g2.drawXBM(8, 23, 16, 8, image_download_1_bits);
  u8g2.setFont(u8g2_font_6x10_tr);
  u8g2.drawStr(17, 13, "Mensajes ESP NOW");
  u8g2.drawFrame(40, 22, 54, 35);
  u8g2.drawLine(41, 23, 68, 43);
  u8g2.drawLine(41, 24, 68, 44);
  u8g2.drawLine(66, 43, 93, 23);
  u8g2.drawLine(66, 44, 93, 24);
  u8g2.drawBox(65, 41, 4, 4);
}

void drawMeshTerm() {
  u8g2.setFontMode(1);
  u8g2.setBitmapMode(1);
  u8g2.drawXBM(8, 40, 16, 8, image_download_bits);
  u8g2.drawXBM(8, 23, 16, 8, image_download_1_bits);
  u8g2.setFont(u8g2_font_6x10_tr);
  u8g2.drawStr(32, 9, "Terminal de");
  u8g2.drawStr(40, 18, "Mensajes");
  u8g2.drawFrame(37, 23, 54, 35);
  u8g2.drawLine(41, 30, 52, 40);
  u8g2.drawLine(41, 29, 52, 39);
  u8g2.drawLine(41, 31, 52, 41);
  u8g2.drawLine(41, 50, 52, 40);
  u8g2.drawLine(41, 49, 52, 39);
  u8g2.drawLine(41, 48, 52, 38);
  u8g2.drawBox(55, 48, 25, 3);
}



void screenAppsLoop() {
  if (isButtonJustPressed(PIN_BACK)) {
    buzzerClick();
    currentScreen = SCREEN_MENU;
    return;
  }

  if (isButtonJustPressed(PIN_UP)) {
    buzzerClick();
    appSelection--;
    if (appSelection < 0) {
      appSelection = TOTAL_APPS - 1;
    }
  }

  if (isButtonJustPressed(PIN_DOWN)) {
    buzzerClick();
    appSelection++;
    if (appSelection >= TOTAL_APPS) {
      appSelection = 0;
    }
  }

  if (isButtonJustPressed(PIN_SELECT)) {
    buzzerBeep();
    switch(appSelection) {
      case 0:
        currentScreen = SCREEN_CAPTIVE;
        break;
      case 1:
        currentScreen = SCREEN_APFLOOD;
        break;
      case 2:
        currentScreen = SCREEN_BTSPAM;
        break;
      case 3:
        currentScreen = SCREEN_GPS;
        break;
      case 4:
        break;
      case 5:
        currentScreen = SCREEN_SNIFFER;
        break;
      case 6:
        currentScreen = SCREEN_PCMODE;
        break;
      case 7:
        currentScreen = SCREEN_YMODEM;
        break;
      case 8:
        currentScreen = SCREEN_BLESCAN;
        break;
      case 9:
        currentScreen = SCREEN_MSGPRESET;
        break;
      case 10:
        currentScreen = SCREEN_MESHTERM;
        break;
    }
  }

  u8g2.clearBuffer();

  switch(appSelection) {
    case 0:
      drawWifiCaptivePortal();
      break;
    case 1:
      drawAPFlood();
      break;
    case 2:
      drawBluetoothSpam();
      break;
    case 3:
      drawGPSPosition();
      break;
    case 4:
      drawWardriving();
      break;
    case 5:
      drawSniffer();
      break;
    case 6:
      drawPCMode();
      break;
    case 7:
      drawYModem();
      break;
    case 8:
      drawBleScan();
      break;
    case 9:
      drawMsgPreset();
      break;
    case 10:
      drawMeshTerm();
      break;
  }

  u8g2.sendBuffer();
}
