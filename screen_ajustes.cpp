#include "Ajustes/screen_ajustes.h"
#include "Drivers/buzzer.h"

static const unsigned char image_Layer_13_bits[] PROGMEM = {
  0x00,0x00,0x00,0x00,0x00,0x00,0x00,0x00,0x00,0x00,0x00,0x00,0x00,0x00,0x00,0x00,
  0x00,0x00,0x00,0x00,0x00,0x00,0x00,0x00,0x00,0x00,0x00,0x00,0x00,0xfe,0xff,0x0f,
  0x00,0x01,0x00,0x10,0x00,0x9f,0x79,0x17,0x00,0x9f,0x79,0x17,0x00,0x11,0x61,0x16,
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  0x00,0x00,0x00,0x00,0x00,0x00,0x00,0x00,0x00,0x00,0x00,0x00,0x00,0x00,0x00,0x00
};

static const unsigned char image_Layer_15_bits[] PROGMEM = {
  0x00,0x00,0x00,0x00,0x00,0x00,0x00,0x00,0x00,0x00,0x00,0x00,0x00,0x00,0x00,0x00,
  0x00,0x00,0x00,0x00,0x00,0x00,0x00,0x00,0x00,0x00,0x00,0x00,0x00,0xfe,0xff,0x0f,
  0x00,0x01,0x00,0x10,0x00,0x9f,0x79,0x17,0x00,0x9f,0x79,0x17,0x00,0x11,0x61,0x16,
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  0x00,0x00,0x00,0x00,0x00,0x00,0x00,0x00,0x00,0x00,0x00,0x00,0x00,0x00,0x00,0x00
};

static const unsigned char image_Layer_17_bits[] PROGMEM = {
  0x00,0x00,0x00,0x00,0x00,0x00,0x00,0x00,0x00,0x00,0x00,0x00,0x00,0x00,0x00,0x00,
  0x00,0x00,0x00,0x00,0x00,0x00,0x00,0x00,0x00,0x00,0x00,0x00,0x00,0xfe,0xff,0x0f,
  0x00,0x01,0x00,0x10,0x00,0x9f,0x79,0x17,0x00,0x9f,0x79,0x17,0x00,0x11,0x61,0x16,
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  0x00,0x00,0x00,0x00,0x00,0x00,0x00,0x00,0x00,0x00,0x00,0x00,0x00,0x00,0x00,0x00
};

static const unsigned char image_Layer_20_bits[] PROGMEM = {
  0x00,0x00,0x00,0x00,0x00,0x00,0x00,0x00,0x00,0x00,0x00,0x00,0x00,0x00,0x00,0x00,
  0x00,0x00,0x00,0x00,0x00,0x00,0x00,0x00,0x00,0x00,0x00,0x00,0x00,0xfe,0xff,0x0f,
  0x00,0x01,0x00,0x10,0x00,0x9f,0x79,0x17,0x00,0x9f,0x79,0x17,0x00,0x11,0x61,0x16,
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  0x00,0x00,0x00,0x00,0x00,0x00,0x00,0x00,0x00,0x00,0x00,0x00,0x00,0x00,0x00,0x00
};

static const unsigned char image_Layer_4_bits[] PROGMEM = {
  0x01,0x03,0x07,0x0f,0x07,0x03,0x01
};

static const unsigned char image_Layer_9_bits[] PROGMEM = {
  0x7e,0x7e,0x7e,0x7e,0x99,0x99,0x99,0x99,
  0x67,0xe6,0x67,0xe6,0x18,0x18,0x18,0x18,
  0x67,0xe6,0x67,0xe6,0x99,0x99,0x99,0x99,
  0x7e,0x7e,0x7e,0x7e
};

static int menuSelection = 0;
static const int MENU_ITEMS = 6;
static unsigned long lastAnimTime = 0;
static int animFrame = 0;

static bool isButtonJustPressed(int pin) {
  static uint8_t lastStableState[4] = {HIGH, HIGH, HIGH, HIGH};
  static uint8_t lastReading[4]     = {HIGH, HIGH, HIGH, HIGH};
  static unsigned long lastDebounceTime[4] = {0, 0, 0, 0};

  const int pins[4] = {PIN_SELECT, PIN_UP, PIN_DOWN, PIN_BACK};
  int index = -1;

  for (int i = 0; i < 4; i++) {
    if (pins[i] == pin) {
      index = i;
      break;
    }
  }
  if (index == -1) return false;

  uint8_t reading = digitalRead(pin);

  if (reading != lastReading[index]) {
    lastDebounceTime[index] = millis();
    lastReading[index] = reading;
  }

  if ((millis() - lastDebounceTime[index]) > 50) {
    if (lastStableState[index] == HIGH && reading == LOW) {
      lastStableState[index] = reading;
      return true;
    }
    lastStableState[index] = reading;
  }

  return false;
}

static const int VISIBLE_ITEMS = 5;

void screenAjustesLoop() {
  if (isButtonJustPressed(PIN_UP)) {
    menuSelection--;
    if (menuSelection < 0) menuSelection = MENU_ITEMS - 1;
    buzzerClick();
  }
  
  if (isButtonJustPressed(PIN_DOWN)) {
    menuSelection++;
    if (menuSelection >= MENU_ITEMS) menuSelection = 0;
    buzzerClick();
  }
  
  if (isButtonJustPressed(PIN_SELECT)) {
    buzzerBeep();
    switch(menuSelection) {
      case 0: currentScreen = SCREEN_CONFIG; break;
      case 1: currentScreen = SCREEN_SDBROWSER; break;
      case 2: currentScreen = SCREEN_RGBNEO; break;
      case 3: currentScreen = SCREEN_AJUSTES_TERM; break;
      case 4: currentScreen = SCREEN_BTSPAM_CONFIG; break;
      case 5: currentScreen = SCREEN_REMOTE; break;
    }
    return;
  }
  
  if (isButtonJustPressed(PIN_BACK)) {
    currentScreen = SCREEN_MENU;
    buzzerClick();
    return;
  }
  
  unsigned long currentTime = millis();
  if (currentTime - lastAnimTime > 150) {
    animFrame = (animFrame + 1) % 5;
    lastAnimTime = currentTime;
  }
  
  u8g2.clearBuffer();
  u8g2.setFontMode(1);
  u8g2.setBitmapMode(1);
  u8g2.setFont(u8g2_font_6x10_tr);
  
  u8g2.setDrawColor(1);
  u8g2.drawBox(16, 1, 96, 14);
  u8g2.setDrawColor(2);
  u8g2.drawStr(38, 11, "AJUSTES");
  u8g2.setDrawColor(1);
  
  u8g2.drawXBM(0, 1, 16, 14, image_Layer_9_bits);
  u8g2.drawXBM(112, 1, 16, 14, image_Layer_9_bits);
  
  const char* items[] = {"Configuracion", "SD Storage", "NEOPIXEL", "Terminal Avz.", "BT Spam", "Con. Remota"};

  int scrollTop = menuSelection - (VISIBLE_ITEMS - 1);
  if (scrollTop < 0) scrollTop = 0;
  int maxTop = MENU_ITEMS - VISIBLE_ITEMS;
  if (maxTop < 0) maxTop = 0;
  if (scrollTop > menuSelection) scrollTop = menuSelection;
  if (scrollTop > maxTop) scrollTop = maxTop;

  const int rowSpacing = 9;
  const int firstY = 22;

  for (int row = 0; row < VISIBLE_ITEMS; row++) {
    int i = scrollTop + row;
    if (i >= MENU_ITEMS) break;
    int yy = firstY + row * rowSpacing;
    if (i == menuSelection) {
      u8g2.drawXBM(2, yy - 7, 4, 7, image_Layer_4_bits);
    }
    u8g2.drawStr(12, yy, items[i]);
  }

  if (scrollTop > 0) {
    u8g2.drawTriangle(122, 20, 126, 20, 124, 17);
  }
  if (scrollTop + VISIBLE_ITEMS < MENU_ITEMS) {
    u8g2.drawTriangle(122, 54, 126, 54, 124, 57);
  }
  
  switch(animFrame) {
    case 0: u8g2.drawXBM(85, 36, 32, 32, image_Layer_13_bits); break;
    case 1: u8g2.drawXBM(85, 36, 32, 32, image_Layer_15_bits); break;
    case 2: u8g2.drawXBM(85, 36, 32, 32, image_Layer_17_bits); break;
    case 3: u8g2.drawXBM(85, 36, 32, 32, image_Layer_15_bits); break;
    case 4: u8g2.drawXBM(85, 36, 32, 32, image_Layer_20_bits); break;
  }
  
  int ellipseFrame = (animFrame / 2) % 3;
  if (ellipseFrame >= 0) u8g2.drawEllipse(117, 56, 1, 1);
  if (ellipseFrame >= 1) u8g2.drawEllipse(121, 56, 1, 1);
  if (ellipseFrame >= 2) u8g2.drawEllipse(125, 56, 1, 1);
  
  u8g2.sendBuffer();
}
